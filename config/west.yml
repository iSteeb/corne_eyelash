## config/west.yml
```yaml
manifest:
  remotes:
    - name: zmkfirmware
      url-base: https://github.com/zmkfirmware
    - name: urob
      url-base: https://github.com/urob
    - name: ssbb
      url-base: https://github.com/ssbb
    - name: m165437
      url-base: https://github.com/M165437
  projects:
    - name: zmk
      remote: zmkfirmware
      revision: v0.3.0
      import: app/west.yml
    - name: eyelash_corne
      url: https://github.com/a741725193/zmk-new_corne
      revision: d6e05a1  # last commit before the board→shield restructure (20ca19a, 2026-06-05) removed boards/arm/eyelash_corne
    - name: zmk-leader-key
      remote: urob
      revision: v0.3
    - name: zmk-auto-layer
      remote: urob
      revision: v0.3
    - name: zmk-listeners
      remote: ssbb
      revision: v1
    - name: nice-view-gem
      remote: m165437
      revision: main
  self:
    path: config
```
